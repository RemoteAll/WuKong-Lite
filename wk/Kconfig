## wk/Kconfig
```kconfig
#
# WuKong-Lite 顶层 Kconfig（结构对齐 Luban-Lite）
#
mainmenu "WuKong-Lite Configuration"

config PRJ_DEFCONFIG_FILENAME
    string
    default ""

config PRJ_CHIP
    string "SoC"
    default "d13x"

config PRJ_BOARD
    string "Board"
    default "demo88-nor"

config PRJ_KERNEL
    string "Kernel"
    default "rt-thread"

config PRJ_APP
    string "Application"
    default "helloworld"

menu "Kernel"

config KERNEL_RT_THREAD
    bool "RT-Thread 5.x"
    default y

config KERNEL_BAREMETAL
    bool "Baremetal"
    default n

config KERNEL_HEAP_SIZE
    int "Kernel heap size"
    default 1048576

endmenu

menu "Build options"

config AIC_IMAGE_PACK
    bool "Auto packing images after build"
    default y

config AIC_IMAGE_META_ALIGN
    int "Component meta alignment"
    default 512

endmenu

source "target/d13x/Kconfig.chip"
source "target/d13x/demo88-nor/Kconfig.board"
```

## wk/target/configs/d13x_demo88-nor_rt-thread_helloworld_defconfig
```kconfig
CONFIG_PRJ_DEFCONFIG_FILENAME="d13x_demo88-nor_rt-thread_helloworld_defconfig"
CONFIG_PRJ_CHIP="d13x"
CONFIG_PRJ_BOARD="demo88-nor"
CONFIG_PRJ_KERNEL="rt-thread"
CONFIG_PRJ_APP="helloworld"
CONFIG_KERNEL_RT_THREAD=y
CONFIG_KERNEL_HEAP_SIZE=1048576
CONFIG_AIC_CHIP_D13X=y
CONFIG_AIC_CMU_DRV=y
CONFIG_AIC_GPIO_DRV=y
CONFIG_AIC_UART_DRV=y
CONFIG_AIC_MAILBOX_DRV=y
CONFIG_AIC_USING_UART0=y
CONFIG_AIC_USING_GPIO=y
CONFIG_AIC_CONSOLE_DEVICE="uart0"
CONFIG_AIC_BOARD_DEMO88_NOR=y
CONFIG_AIC_BOARD_MEDIA="spi-nor"
CONFIG_AIC_BOARD_SPINOR_SIZE="16m"
CONFIG_AIC_BOARD_CONSOLE="uart0"
CONFIG_AIC_BOARD_CONSOLE_BAUD=115200
CONFIG_AIC_BOOTLOADER_LOAD_BASE=0x40100000
CONFIG_AIC_BOOTLOADER_TEXT_BASE=0x40100000
CONFIG_AIC_IMAGE_PACK=y
```

## wk/target/d13x/Kconfig.chip
```kconfig
#
# d13x 芯片能力清单（对应 Luban-Lite `sys/<soc>/Kconfig.chip`）
#
menu "SoC d13x"

config AIC_CHIP_D13X
    bool "ArtInChip D13x"
    default y

config AIC_CHIP_FAMILY
    string
    default "artinchip-d13x"

config AIC_CMU_DRV
    bool "CMU (clock) driver"
    default y

config AIC_CMU_DRV_VER
    string "CMU HAL version"
    default "31"

config AIC_GPIO_DRV
    bool "GPIO driver"
    default y

config AIC_GPIO_DRV_VER
    string
    default "21"

config AIC_UART_DRV
    bool "UART driver"
    default y

config AIC_UART_DRV_VER
    string
    default "14"

config AIC_MAILBOX_DRV
    bool "Mailbox driver"
    default y

config AIC_MAILBOX_DRV_VER
    string
    default "11"

config AIC_USING_UART0
    bool "Enable UART0 (console)"
    default y

config AIC_USING_GPIO
    bool "Enable GPIO"
    default y

config AIC_CONSOLE_DEVICE
    string "Console device name"
    default "uart0"

config AIC_IRQ_STACK_SIZE
    int "Interrupt stack size"
    default 4096

endmenu
```

## wk/target/d13x/demo88-nor/Kconfig.board
```kconfig
#
# demo88-nor 板级配置（对应 `target/<soc>/<board>/Kconfig.board`）
#
menu "Board demo88-nor"

config AIC_BOARD_DEMO88_NOR
    bool "demo88-nor"
    default y

config AIC_BOARD_MEDIA
    string "Boot media"
    default "spi-nor"

config AIC_BOARD_SPINOR_SIZE
    string "SPI NOR size"
    default "16m"

config AIC_BOARD_CONSOLE
    string "Board console"
    default "uart0"

config AIC_BOARD_CONSOLE_BAUD
    int "Console baud rate"
    default 115200

config AIC_BOOTLOADER_LOAD_BASE
    hex "Bootloader load address"
    default 0x40100000

config AIC_BOOTLOADER_TEXT_BASE
    hex "Bootloader entry address"
    default 0x40100000

config AIC_USING_LVGL
    bool "Enable LVGL UI"
    default n

config AIC_LVGL_COLOR_DEPTH
    int "LVGL color depth"
    depends on AIC_USING_LVGL
    default 16

endmenu
```
